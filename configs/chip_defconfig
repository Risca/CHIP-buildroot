## configs/chip_defconfig
```kconfig
BR2_arm=y
BR2_cortex_a8=y
BR2_ARM_EABIHF=y
BR2_BACKUP_SITE="http://sources.buildroot.net/"
BR2_KERNEL_MIRROR="http://www.kernel.org/pub/"
BR2_LUAROCKS_MIRROR="http://luarocks.org/repositories/rocks"
BR2_CPAN_MIRROR="http://search.cpan.org/CPAN"
BR2_PACKAGE_OVERRIDE_FILE="$(TOPDIR)/local.mk"
BR2_TOOLCHAIN_EXTERNAL=y
BR2_ENABLE_LOCALE_PURGE=y
BR2_ENABLE_LOCALE_WHITELIST="C en_US"
BR2_TARGET_OPTIMIZATION="-pipe"
BR2_TARGET_GENERIC_HOSTNAME="chip"
BR2_TARGET_GENERIC_ROOT_PASSWD="chip"
BR2_TARGET_GENERIC_GETTY_BAUDRATE_115200=y
BR2_TARGET_TZ_INFO=y
BR2_TARGET_TZ_ZONELIST="etcetera europe"
BR2_TARGET_LOCALTIME="Europe/Stockholm"
BR2_ROOTFS_USERS_TABLES="board/nextthing/chip/users_table.txt"
BR2_ROOTFS_OVERLAY="board/nextthing/chip/overlay"
BR2_ROOTFS_POST_BUILD_SCRIPT="board/nextthing/chip/post-build.sh"
BR2_ROOTFS_POST_IMAGE_SCRIPT="board/nextthing/chip/post-image.sh"
BR2_LINUX_KERNEL=y
BR2_LINUX_KERNEL_CUSTOM_GIT=y
BR2_LINUX_KERNEL_CUSTOM_REPO_URL="https://github.com/NextThingCo/CHIP-linux.git"
BR2_LINUX_KERNEL_CUSTOM_REPO_VERSION="debian/4.4.13-ntc-mlc"
BR2_LINUX_KERNEL_PATCH="$(TOPDIR)/board/nextthing/chip/patches/linux"
BR2_LINUX_KERNEL_USE_CUSTOM_CONFIG=y
BR2_LINUX_KERNEL_CUSTOM_CONFIG_FILE="board/nextthing/chip/linux-minimal.config"
BR2_LINUX_KERNEL_ZIMAGE=y
BR2_LINUX_KERNEL_DTS_SUPPORT=y
BR2_LINUX_KERNEL_INTREE_DTS_NAME="sun5i-r8-chip"
BR2_LINUX_KERNEL_INSTALL_TARGET=y
BR2_PACKAGE_BUSYBOX_CONFIG="board/nextthing/chip/busybox.config"
BR2_PACKAGE_BUSYBOX_SHOW_OTHERS=y
BR2_PACKAGE_ALSA_UTILS=y
BR2_PACKAGE_ALSA_UTILS_APLAY=y
BR2_PACKAGE_SQUEEZELITE=y
BR2_PACKAGE_STRESS=y
BR2_PACKAGE_MMC_UTILS=y
BR2_PACKAGE_MTD=y
BR2_PACKAGE_MTD_MKFSUBIFS=y
BR2_PACKAGE_I2C_TOOLS=y
BR2_PACKAGE_LSHW=y
BR2_PACKAGE_LSUIO=y
BR2_PACKAGE_PCIUTILS=y
BR2_PACKAGE_LIBSNDFILE=y
BR2_PACKAGE_CA_CERTIFICATES=y
BR2_PACKAGE_LIBUSB=y
BR2_PACKAGE_JSON_C=y
BR2_PACKAGE_LIBLOGGING=y
BR2_PACKAGE_LIBESTR=y
BR2_PACKAGE_AVAHI=y
BR2_PACKAGE_AVAHI_DAEMON=y
BR2_PACKAGE_AVAHI_LIBDNSSD_COMPATIBILITY=y
BR2_PACKAGE_BLUEZ5_UTILS=y
BR2_PACKAGE_BLUEZ5_UTILS_OBEX=y
BR2_PACKAGE_BLUEZ5_UTILS_CLIENT=y
BR2_PACKAGE_BLUEZ5_UTILS_GATTTOOL=y
BR2_PACKAGE_BLUEZ5_UTILS_EXPERIMENTAL=y
BR2_PACKAGE_CONNMAN=y
BR2_PACKAGE_CONNMAN_WIFI=y
BR2_PACKAGE_CONNMAN_WISPR=y
BR2_PACKAGE_CONNMAN_BLUETOOTH=y
BR2_PACKAGE_CONNMAN_CLIENT=y
BR2_PACKAGE_DHCPCD=y
BR2_PACKAGE_IPERF3=y
BR2_PACKAGE_IPROUTE2=y
BR2_PACKAGE_IW=y
BR2_PACKAGE_NTP=y
BR2_PACKAGE_NTP_SNTP=y
BR2_PACKAGE_OPENSSH=y
BR2_PACKAGE_RTL8723BS_BT=y
BR2_PACKAGE_RTL8723BS_BT_CUSTOM_GIT=y
BR2_PACKAGE_RTL8723BS_BT_CUSTOM_REPO_URL="https://github.com/NextThingCo/rtl8723bs_bt"
BR2_PACKAGE_RTL8723BS_BT_CUSTOM_REPO_VERSION="debian"
BR2_PACKAGE_RTL8723BS_MP_DRIVER=y
BR2_PACKAGE_TCPDUMP=y
BR2_PACKAGE_WGET=y
BR2_PACKAGE_WPA_SUPPLICANT_AP_SUPPORT=y
BR2_PACKAGE_WPA_SUPPLICANT_EAP=y
BR2_PACKAGE_WPA_SUPPLICANT_HOTSPOT=y
BR2_PACKAGE_WPA_SUPPLICANT_DEBUG_SYSLOG=y
BR2_PACKAGE_WPA_SUPPLICANT_CLI=y
BR2_PACKAGE_WPA_SUPPLICANT_DBUS_INTROSPECTION=y
BR2_PACKAGE_SUDO=y
BR2_PACKAGE_KMOD=y
BR2_PACKAGE_KMOD_TOOLS=y
BR2_PACKAGE_MENDER=y
BR2_PACKAGE_PROCPS_NG=y
BR2_TARGET_ROOTFS_UBIFS=y
BR2_TARGET_ROOTFS_UBIFS_LEBSIZE=0x1f8000
BR2_TARGET_ROOTFS_UBIFS_MINIOSIZE=0x4000
BR2_TARGET_ROOTFS_UBIFS_MAXLEBCNT=4096
BR2_TARGET_ROOTFS_UBIFS_LZO=y
BR2_TARGET_ROOTFS_UBI=y
BR2_TARGET_ROOTFS_UBI_PEBSIZE=0x400000
BR2_TARGET_ROOTFS_UBI_SUBSIZE=0
BR2_TARGET_ROOTFS_UBI_USE_CUSTOM_CONFIG=y
BR2_TARGET_ROOTFS_UBI_CUSTOM_CONFIG_FILE="$(TOPDIR)/board/nextthing/chip/ubi.cfg"
BR2_TARGET_ROOTFS_UBI_OPTS="-M dist3"
BR2_TARGET_UBOOT=y
BR2_TARGET_UBOOT_BOARDNAME="CHIP"
BR2_TARGET_UBOOT_CUSTOM_GIT=y
BR2_TARGET_UBOOT_CUSTOM_REPO_URL="https://github.com/NextThingCo/CHIP-u-boot.git"
BR2_TARGET_UBOOT_CUSTOM_REPO_VERSION="production-mlc"
BR2_TARGET_UBOOT_PATCH="$(TOPDIR)/board/nextthing/chip/patches/u-boot"
BR2_TARGET_UBOOT_FORMAT_CUSTOM=y
BR2_TARGET_UBOOT_FORMAT_CUSTOM_NAME="u-boot-dtb.bin"
BR2_TARGET_UBOOT_SPL=y
BR2_TARGET_UBOOT_SPL_NAME="spl/sunxi-spl.bin spl/sunxi-spl-with-ecc.bin"
BR2_TARGET_UBOOT_ENVIMAGE=y
BR2_TARGET_UBOOT_ENVIMAGE_SOURCE="board/nextthing/chip/uboot-env"
BR2_TARGET_UBOOT_ENVIMAGE_SIZE="0x400000"
BR2_PACKAGE_HOST_DTC_OVERLAY=y
BR2_PACKAGE_HOST_MENDER_ARTIFACT=y
BR2_PACKAGE_HOST_MTD=y
```

## package/mender/Config.in
```kconfig
config BR2_PACKAGE_MENDER
	bool "mender"
	depends on BR2_PACKAGE_HOST_GO_ARCH_SUPPORTS
	depends on BR2_PACKAGE_HOST_GO_CGO_LINKING_SUPPORTS
	depends on BR2_TOOLCHAIN_HAS_THREADS
	help
	  Mender is an open source tool for updating your
	  embedded devices safely and reliably

	  https://github.com/mendersoftware

if BR2_PACKAGE_MENDER

config BR2_PACKAGE_MENDER_CONFIG
	string "configuration file"
	help
	  Much of the Mender client's configuration resides in
	  /etc/mender/mender.conf on the root filesystem. This file is JSON
	  structured and defines various parameters for Mender's operation.

config BR2_PACKAGE_MENDER_PERSISTENT_DATA
	bool "create symlink to data partition"
	help
	  Symlink /var/lib/mender to /data/mender to allow persistent data
	  across updates.

config BR2_PACKAGE_MENDER_SERVER_CERT
	string "server certificates file"
	help
	  The server certificates file is a concatenation of all certificates
	  that the Mender client use. It is used for server verification when
	  using HTTPS.

config BR2_PACKAGE_MENDER_ARTIFACT_VERIFY_KEY
	string "artifact verification key"
	help
	  The artifact verification key is used by the mender client to verify
	  artifacts. Leave empty to disable.

endif

comment "mender needs a toolchain w/ threads"
	depends on BR2_PACKAGE_HOST_GO_ARCH_SUPPORTS && \
		BR2_PACKAGE_HOST_GO_CGO_LINKING_SUPPORTS
	depends on !BR2_TOOLCHAIN_HAS_THREADS
```

## package/squeezelite/Config.in
```kconfig
config BR2_PACKAGE_SQUEEZELITE
	bool "squeezelite"
	select BR2_PACKAGE_ALSA_LIB
	select BR2_PACKAGE_FAAD2
	select BR2_PACKAGE_FFMPEG
	select BR2_PACKAGE_FLAC
	select BR2_PACKAGE_LIBMAD
	select BR2_PACKAGE_LIBOGG
	select BR2_PACKAGE_LIBVORBIS
	select BR2_PACKAGE_MPG123
	select BR2_PACKAGE_LIBSOXR
	help
	  Squeezelite. Squeezelite is a headless (no user interface)
	  software music player that allows you to play music streamed
	  from Logitech Media Server.

	  https://github.com/ralph-irving/squeezelite
```
